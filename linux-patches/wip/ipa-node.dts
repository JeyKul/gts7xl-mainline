		ipa@1e40000 {
			compatible = "qcom,sm8250-ipa";
			iommus = <0x33 0x5c0 0x00 0x33 0x5c2 0x00>;
			reg = <0x00 0x1e40000 0x00 0x7000 0x00 0x1e50000 0x00 0x4b20 0x00 0x1e04000 0x00 0x23000>;
			reg-names = "ipa-reg", "ipa-shared", "gsi";
			interrupts-extended = <0x01 0x00 0x137 0x01 0x01 0x00 0x1b0 0x04>;
			interrupt-names = "ipa", "gsi";
			clocks = <0x30 0x0c>;
			clock-names = "core";
			interconnects = <0x49 0x05 0x00 0x09 0x01 0x00 0x49 0x05 0x00 0x7ff0 0x0b 0x00 0x08 0x02 0x00 0x38 0x14 0x00>;
			interconnect-names = "memory", "imem", "config";
			qcom,qmp = <0x9b>;
			qcom,gsi-loader = "self";
			memory-region = <0x117 0x116>;
			firmware-name = "qcom/sm8250/gts7xl/ipa_fws.mdt";
			qcom,uc-firmware-name = "qcom/sm8250/gts7xl/ipa_uc.mdt";
		};
